#include <ArduinoWebsockets.h>
#include <WiFi.h>
#include <ESPAsyncWebServer.h>
#include "esp_camera.h"


const uint8_t index_html_gz[] = { 0x1f,0x8b,0x08,0x08,0xdf,0xc5,0x68,0x65,0x00,0xff,0x69,0x6e,0x64,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0x00,0x00 };
  
String mensagem;


// Motor A
const int motor1Pin1 = 2;
const int motor1Pin2 = 14;
const int enable1Pin = 12;

// Motor B
const int motor2Pin1 = 15;
const int motor2Pin2 = 13;
const int enable2Pin = 0;

const int freq = 30000;
const int pwmChannel = 0;
//const uint8_t resolution = 8;
int velocidade = 255;

// motores


#define PWDN_GPIO_NUM     32
#define RESET_GPIO_NUM    -1
#define XCLK_GPIO_NUM      0
#define SIOD_GPIO_NUM     26
#define SIOC_GPIO_NUM     27
#define Y9_GPIO_NUM       35
#define Y8_GPIO_NUM       34
#define Y7_GPIO_NUM       39
#define Y6_GPIO_NUM       36
#define Y5_GPIO_NUM       21
#define Y4_GPIO_NUM       19
#define Y3_GPIO_NUM       18
#define Y2_GPIO_NUM        5
#define VSYNC_GPIO_NUM    25
#define HREF_GPIO_NUM     23
#define PCLK_GPIO_NUM     22
 
camera_fb_t * fb = NULL;
 
using namespace websockets;
WebsocketsServer server;

int btnGPIO = 0;
int btnState = false;

const char *ssid = "Carrinho";
const char *password = "Carrinho";

AsyncWebServer webserver(80);
 
void setup()
{

  ESP32PWM::allocateTimer(0);
  ESP32PWM::allocateTimer(1);
  ESP32PWM::allocateTimer(2);
  ESP32PWM::allocateTimer(3);
  horizontal.setPeriodHertz(50);    // standard 50 hz servo
  horizontal.attach(19, 1000, 2000);  
  vertical.setPeriodHertz(50);    // standard 50 hz servo
  vertical.attach(21, 1000, 2000); 
  horizontal.write(90);
  vertical.write(90);

  Serial.begin(115200);
  pinMode(btnGPIO, INPUT);

  WiFi.softAP(ssid, password);
  IPAddress IP = WiFi.softAPIP();
  
  Serial.begin(115200);
  Serial.print("Endereço IP do AP: ");
  Serial.println(IP);

  
  pinMode(motor1Pin1, OUTPUT);
  pinMode(motor1Pin2, OUTPUT);
  pinMode(enable1Pin, OUTPUT);

  pinMode(motor2Pin1, OUTPUT);
  pinMode(motor2Pin2, OUTPUT);
  pinMode(enable2Pin, OUTPUT);
  
  // configure LED PWM functionalitites
  ledcSetup(pwmChannel, freq, 8);

  // attach the channel to the GPIO to be controlled
  ledcAttachPin(enable1Pin, pwmChannel);  
  ledcAttachPin(enable2Pin, pwmChannel);

  ledcWrite(pwmChannel, velocidade);

 
  camera_config_t config;
  config.ledc_channel = LEDC_CHANNEL_0;
  config.ledc_timer = LEDC_TIMER_0;
  config.pin_d0 = Y2_GPIO_NUM;
  config.pin_d1 = Y3_GPIO_NUM;
  config.pin_d2 = Y4_GPIO_NUM;
  config.pin_d3 = Y5_GPIO_NUM;
  config.pin_d4 = Y6_GPIO_NUM;
  config.pin_d5 = Y7_GPIO_NUM;
  config.pin_d6 = Y8_GPIO_NUM;
  config.pin_d7 = Y9_GPIO_NUM;
  config.pin_xclk = XCLK_GPIO_NUM;
  config.pin_pclk = PCLK_GPIO_NUM;
  config.pin_vsync = VSYNC_GPIO_NUM;
  config.pin_href = HREF_GPIO_NUM;
  config.pin_sscb_sda = SIOD_GPIO_NUM;
  config.pin_sscb_scl = SIOC_GPIO_NUM;
  config.pin_pwdn = PWDN_GPIO_NUM;
  config.pin_reset = RESET_GPIO_NUM;
  config.xclk_freq_hz = 20000000;
  config.pixel_format = PIXFORMAT_JPEG;
  //init with high specs to pre-allocate larger buffers
  
  if (psramFound()) {
    config.frame_size = FRAMESIZE_UXGA;
    config.jpeg_quality = 10;
    config.fb_count = 2;
  } else {
    config.frame_size = FRAMESIZE_SVGA;
    config.jpeg_quality = 12;
    config.fb_count = 1;
  }
   
  // camera init
  esp_err_t err = esp_camera_init(&config);
  if (err != ESP_OK) {
    Serial.printf("Camera init failed with error 0x%x", err);
    return;
  }
 
  sensor_t * s = esp_camera_sensor_get();
  s->set_framesize(s, FRAMESIZE_SVGA);
 


 
  webserver.on("/", HTTP_GET, [](AsyncWebServerRequest * request) {
    AsyncWebServerResponse *response = request->beginResponse_P(200, "text/html", index_html_gz, sizeof(index_html_gz));
    response->addHeader("Content-Encoding", "gzip");
    request->send(response);
  });
 
  webserver.begin();
  server.listen(81);
  

  
  Serial.print("Is server live? ");
  Serial.println(server.available());
 
}
 //handleWebSocketMessage
void handle_message(WebsocketsMessage msg) {
   mensagem = msg.data();
   Serial.println(mensagem);

   // vertical.write(servov);
   // horizontal.write(servov);

  if (mensagem == "1"){
      frente();
      }  
  if (mensagem == "2"){
      tras();
      }  
  if (mensagem == "3"){
      gdir();
      }  
  if (mensagem == "4"){
      gesq();  
      }  
  if (mensagem == "0"){
      parado();
      }  
  if (mensagem == "20"){
      //horizontal cima
      }  
  if (mensagem == "10"){
      //horizontal baixo
      }  
  if (mensagem == "30"){
      // vertical cima 
      }  
  if (mensagem == "40"){
      // vertical baixo
      }  
}
 
void loop()
{
  btnState = digitalRead(btnGPIO);
  
  auto client = server.accept();
  client.onMessage(handle_message);
  while (client.available()) {
    client.poll();
        fb = esp_camera_fb_get();
        client.sendBinary((const char *)fb->buf, fb->len);
        esp_camera_fb_return(fb);
        fb = NULL;
  }
}

void parado(){
  digitalWrite(motor1Pin1, LOW);
  digitalWrite(motor1Pin2, LOW);
  digitalWrite(motor2Pin2, LOW);
  digitalWrite(motor2Pin1, LOW);
}

void frente(){
  digitalWrite(motor1Pin1, HIGH);
  digitalWrite(motor1Pin2, LOW);
  digitalWrite(motor2Pin2, HIGH);
  digitalWrite(motor2Pin1, LOW);
}

void tras(){
  digitalWrite(motor1Pin1, LOW);
  digitalWrite(motor1Pin2, HIGH);
  digitalWrite(motor2Pin2, LOW);
  digitalWrite(motor2Pin1, HIGH);
}

void gesq(){
  digitalWrite(motor1Pin1, LOW);
  digitalWrite(motor1Pin2, HIGH);
  digitalWrite(motor2Pin2, HIGH);
  digitalWrite(motor2Pin1, LOW);
}

void gdir(){
  digitalWrite(motor1Pin1, HIGH);
  digitalWrite(motor1Pin2, LOW);
  digitalWrite(motor2Pin2, LOW);
  digitalWrite(motor2Pin1, HIGH);
}
